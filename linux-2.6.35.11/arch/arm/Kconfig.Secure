## linux-2.6.35.11/arch/arm/Kconfig.Secure
```kconfig
#menu Samsung

## SELP Menu Start: config file  for SELP Features #############################
## MS.PARK 08.07
menu "CI+ Option"

config EXECUTE_AUTHULD
       default n
       bool "Execute authuld program on background"
       help
         decide whether executing authuld

config SHUTDOWN
        bool "Send shutdown signal to micom"
        default n
        depends on EXECUTE_AUTHULD=y
        help
          decide whether send "shutdown" to micom or not

config AUTHULD_PATH
        string "Path to authuld file"
        default "/bin/authuld"
        depends on EXECUTE_AUTHULD=y
        help
        Allows to redirect authuld files into specified location.

config TIMEOUT_ACK_AUTHULD
        int "Timout of authuld ack(minute)"
        default 3
        depends on EXECUTE_AUTHULD=y
        help
        if kernel do not get ACK from authuld, System will be down.

endmenu # end of "CI+ Option" menu

#endmenu
```

## linux-2.6.35.11/arch/arm/mach-ccep/Kconfig
```kconfig
######################################################################
#
# 	Kconfig for machine about Costom Consumer Electronics 
# 	
# 	created by tukho.kim@samsung.com
#
######################################################################
#
# May,31,2010:	created by tukho.kim
# 

if ARCH_CCEP

choice 
	prompt "Consumer Electronics"
	default SAMSUNG_VD_DTV_PLATFORM

config  SAMSUNG_VD_DTV_PLATFORM
	bool "Samsung VD DTV Platform"
	help
	  This enables support for Samsung co. VD SoC R&D Group DTV Platform

config  SAMSUNG_VD_BD_PLATFORM
	bool "Samsung VD Blue-ray Platform"
	help
	  This enables support for Samsung co. VD SoC R&D Group Blue-ray Platform
endchoice # Consumer Electronics


if SAMSUNG_VD_DTV_PLATFORM
source "arch/arm/mach-ccep/Kconfig.dtv" 
endif # SAMSUNG_VD_DTV_PLATFORM

if SAMSUNG_VD_BD_PLATFORM
source "arch/arm/mach-ccep/Kconfig.bd" 
endif # SAMSUNG_VD_BD_PLATFORM

#
# Discontigmem support 
#
config MACH_MEMORY_TYPE_SUPPORT
	bool 

if MACH_MEMORY_TYPE_SUPPORT

choice
	prompt "Choose System Memory Type"
	default SDP_SPARSEMEM_SUPPORT

config SDP_SPARSEMEM_SUPPORT
	bool "Sparse memory support"
	select ARCH_SPARSEMEM_ENABLE
	help
	  This enables support sparse memory.

config SDP_SINGLE_DDR_A
	bool "only DDR A channel system memory"
	help
	  This enables support only to use A channel for system memory

config SDP_SINGLE_DDR_B
	bool "only DDR B channel system memory"
	help
	  This enables support only to use B channel for system memory

config SDP_SINGLE_DDR_C
	bool "only DDR C channel system memory"
	help
	  This enables support only to use C channel for system memory

endchoice # "Choose System Memory Type"

menu "Select ARM Errata Patch"

config SDP_ARM_A8_ERRATA_586324
	bool "ARM A8 ERRATA 586324 - cache corruption"
	default y if ARCH_SDP1002 || ARCH_SDP1103 || ARCH_SDP1103FPGA
	help
	  This fix ARM_ERRATA_586324. Cache maintenance operation done by MVA can result in a corruption of memory.

config SDP_ARM_A9_ERRATA_754322
	bool "ARM_A9_ERRATA_754322 - MMU faild in ASID switch"
	default y if ARCH_SDP1001 || ARCH_SDP1004 || ARCH_SDP1105 || ARCH_SDP1106 || ARCH_SDP1105FPGA || ARCH_SDP1106FPGA
	help
	  This fix ARM_ERRATA_754322. Possible faulty MMU translations following an ASID switch.

config SDP_ARM_A9_ERRATA_764369
	bool "ARM_A9_ERRATA_764369 - Cache Op failed on Inner Sharable Memory"
	default y if ARCH_SDP1105 || ARCH_SDP1106 || ARCH_SDP1105FPGA || ARCH_SDP1106FPGA
	help
	  This fix ARM_ERRATA_764369. Data or unified cache line maintenance operation by MVA may not succeed on an Inner Shareable memory region.

config SDP_ARM_PL310_ERRATA_752271
	bool "ARM_PL310_ERRATA_752271 - Double linefill feature can cause data corruption"
	default y if ARCH_SDP1105 || ARCH_SDP1106 || ARCH_SDP1105FPGA || ARCH_SDP1106FPGA || ARCH_SDP1004 || ARCH1001
	help
	  This fix PL310_ERRATA_752271. Double linefill feature can cause data corruption.

endmenu

endif # MACH_MEMORY_TYPE_SUPPORT

endif # ARCH_CCEP	
```

## linux-2.6.35.11/arch/mips/Kconfig.SPBSP
```kconfig
menu "Samsung SP/BSP options"
comment "VDLinux 2.x SP/BSP patch"

config DIRTY_BACKGROUND_RATIO
		int "Dirty background ratio"
		default 10
		help
			set dirty background ratio for waking up pdflush kernel thread.

config DIRTY_EXPIRE_INTERVAL
		int "Dirty expire interval"
		default (3000)
		help
			set interval value expiring dirty pages for page writeback operation.

config MODULE_VER_CHECK_SKIP
		bool "Module version check skip"
		default n
		depends on MODVERSIONS=n
		help
		  'PRINT_MODULE_ADDR' option change VERMAGIC_STRING value. (e.g. 1003_192 DEBUG)
		  so, If you are using different version name, insmod will be failed
		  even while 'MODVERSION' option is off.
		  This option skip the checking the VERMAGIC_STRING.
		
config SQUASHFS_DEBUGGER
		bool "squashfs debugger v1.1"
		default y
		help
		  Tool for debugging squashfs error.
		  It is useful even to debug Flash I/O and memory un-safe problem.

config SQUASHFS_BLOCK_SIZE_1K_TO_4K
		bool "squashfs block size 1K => 4K"
		default y
		help
		  In most of case, To set block size as 4K enhance the performance.

config BLOCK_STOP_TTY
		bool "block stop_tty (Ctrl + S)"
		default y
		help
		 Noise from UART can make stop signal. This option blocks stop_tty.

config BUSYLOOP_WHILE_OOPS
		bool "busyloop while oops"
		default y
		help
		 In case of oops, This option is useful for attach JTAG device.

config PROHIBIT_SIGNAL_HOOKING
                bool "coredump when user try signal_hooking"
                default n
                help
                 In case of user app trying signal hooking, This option can stop user app and create coredump.

config PROHIBIT_USLEEP_0
                bool "coredump when user try usleep(0)"
                default n
                help
                 In case of user app using usleep(0), This option can stop user app and create coredump.

config MOUNT_SECURITY
                bool "security on mount command"
                default n
                help
                 In case of release kernel build mode, This option will disable BIND option and apply NOEXEC option to all devices on mount command

endmenu # end of "Samsung SP/BSP options" menu
```

## linux-2.6.35.11/drivers/Kconfig.DEBUG
```kconfig
menu "Samsung SP DEBUG patch"
comment "VDLinux Debug patch"

config VD_RELEASE
	default n
	bool "Turn on Release mode"
	help
	 Set Debug/Release mode (n : Debug / y : Release)

config RUN_TIMER_DEBUG
   bool "run timer debugging"
   depends on VD_RELEASE=n

config UNHANDLED_IRQ_TRACE_DEBUGGING
   bool "trace unhandled irq tracing"
   depends on VD_RELEASE=n
   default n

config FIND_LONG_TIME_IRQ_HANDLER
   bool "trace irq handler which takes long time(> 1s)"
   depends on UNHANDLED_IRQ_TRACE_DEBUGGING=y
   default n

config CHECK_MOUNT_DEBUG
   bool "mount debugging"
   depends on VD_RELEASE=n
   default n  
   
config FCOUNT_DEBUG
   bool "print f_count when umount fail(task info also is printed when CONFIG_FD_PID is enable) "
   depends on VD_RELEASE=n
   default n  

endmenu
```

## linux-2.6.35.11/drivers/mstar-X10P/nand/Kconfig
```kconfig
config MSTAR_NAND
  select MTD
  select MTD_CHAR
  select MTD_BLKDEVS
  
  select MTD_NAND_PLATFORM
  select MTD_CMDLINE_PARTS
  select MTD_UBI
  
  select MTD_DEBUG
  select MTD_CONCAT
  select MTD_PARTITIONS
  select MTD_NAND
  
  tristate "NAND"
  default n

help
Enable compilation option for hy27us MTD driver

config MSTAR_NAND_IP
	string
	default "fcie3" if MSTAR_TITANIA8 || MSTAR_TITANIA9 || MSTAR_AMBER1

	default "error"
```

## linux-2.6.35.11/drivers/mstar-X10P/usb/fault/Kconfig
```kconfig
#
# USB Fault driver configuration
#

comment "USB Over-current Fault driver"
	depends on USB

config USB_FAULT
	tristate "USB Over-current Fault"
	depends on USB
	default M
```

## linux-2.6.35.11/drivers/nvt/Kconfig
```kconfig
# Config Novatek Platform

menu "Novatek config"

choice
	prompt "Novatek Chip Selection"
	default NVT_NT72558

config NVT_NT72688
	bool "Novatek NT72688 board"
	select DMA_NONCOHERENT
	select ARCH_SPARSEMEM_ENABLE
	select IRQ_CPU
	select IRQ_GIC
	select CEVT_R4K
#	select MIPS_BOARDS_GEN
	select MIPS_CPU_SCACHE
	select SYS_HAS_CPU_MIPS32_R2
	select SYS_HAS_EARLY_PRINTK
	select SYS_SUPPORTS_HIGHMEM
	select SYS_SUPPORTS_32BIT_KERNEL
	select SYS_SUPPORTS_LITTLE_ENDIAN
	select SYS_SUPPORTS_MULTITHREADING
	help
	  This enables support for the NovaTek nt72688 evaluation
	  board.

config NVT_NT72558
	bool "Novatek NT72558 board"
	select DMA_NONCOHERENT
	select ARCH_SPARSEMEM_ENABLE
	select IRQ_CPU
	select CEVT_R4K
	select CSRC_R4K
#	select MIPS_BOARDS_GEN
	select MIPS_CPU_SCACHE
	select SYS_HAS_CPU_MIPS32_R2
	select SYS_HAS_EARLY_PRINTK
	select SYS_SUPPORTS_HIGHMEM
	select SYS_SUPPORTS_32BIT_KERNEL
	select SYS_SUPPORTS_LITTLE_ENDIAN
	select SYS_SUPPORTS_MULTITHREADING
	help
	  This enables support for the NovaTek nt72558 evaluation
	  board.
endchoice

config PULLOUT_INITRAMFS
	bool "Pull-out Initramfs source file from kernel image"
	default n
	help
	  Enable this to pull-out initramfs_data.cpio.gz from vmlinux.

config INITRAMFS_IMG_HDR_ADDR
	hex "Location info of __initramfs_start and __initramfs_end"
	depends on PULLOUT_INITRAMFS
	default 0x88000000
	help
	  The first word contains __initramfs_start. And the second word contains __initramfs_end.

config SET_CLOCK_MANUALLY
	bool "Set clock manually"
	default n

config CPU_CLOCK
	int "CPU clock setting (kHz)"
	depends on SET_CLOCK_MANUALLY
	default 25000

config AHB_CLOCK
	int "AHB clock setting (kHz)"
	depends on SET_CLOCK_MANUALLY
	default 12000

config NVT_MEMPROTECT
	bool "Set Novatek memory protection"
	default y
	help
		Enable novatek hardware memory protection for kernel text and rodata section.
		If someone want to write these sections, it will trigger interrupt.

config EXTERNEL_SYNC
	bool "Enable External SYNC"
	default n
	help 
		System has enabled External SYNC. SYNC instruction would 
		cause a synchonizing transaction on external bus. 

config 64BIT_FPR
	bool "Select 64 bits floating point register"
	depends on NVT_NT72688
	default n

source "drivers/nvt/usb/Kconfig"
endmenu
```

## linux-2.6.35.11/drivers/staging/ramzswap/Kconfig
```kconfig
config RAMZSWAP
	tristate "Compressed in-memory swap device (ramzswap)"
	depends on SWAP
	select LZO_COMPRESS
	select LZO_DECOMPRESS
	default n
	help
	  Creates virtual block devices which can (only) be used as swap
	  disks. Pages swapped to these disks are compressed and stored in
	  memory itself.

	  See ramzswap.txt for more information.
	  Project home: http://compcache.googlecode.com/

config   RAMDEVICES
         int  "Default NO OF RAMDEVICES"
         depends on RAMZSWAP
         default 4
         help

config   DISKDEVICES
         int  "Default size of RAMDEVICES"
         depends on RAMZSWAP
         default 20480
         help

config RAMZSWAP_STATS
	bool "Enable ramzswap stats"
	depends on RAMZSWAP
	default y
	help
	  Enable statistics collection for ramzswap. This adds only a minimal
	  overhead. In unsure, say Y.
```
